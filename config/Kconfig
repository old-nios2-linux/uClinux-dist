## config/Kconfig
```kconfig
#############################################################################

#
#	Kconfig - user space configuration
#

#############################################################################

mainmenu "Linux Application Configuration"

source ../lib/Kconfig

source ../user/Kconfig

#############################################################################
```

## user/busybox/ipsvd/Kconfig
```kconfig
#
# For a description of the syntax of this configuration file,
# see scripts/kbuild/config-language.txt.
#

menu "ipsvd utilities"

config USER_BUSYBOX_TCPSVD
	bool "tcpsvd"
	default n
	help
	  tcpsvd listens on a tcp port and runs a program for each new connection

config USER_BUSYBOX_UDPSVD
	bool "udpsvd"
	default n
	help
	  udpsvd listens on a udp port and runs a program for each new connection

endmenu
```

## user/busybox/selinux/Kconfig
```kconfig
#
# For a description of the syntax of this configuration file,
# see scripts/kbuild/config-language.txt.
#

menu "Selinux Utilities"
	depends on USER_BUSYBOX_SELINUX

config USER_BUSYBOX_CHCON
	bool "chcon"
	default n
	depends on USER_BUSYBOX_SELINUX
	help
	  Enable support to change the security context of file.

config USER_BUSYBOX_FEATURE_CHCON_LONG_OPTIONS
	bool "Enable long options"
	default y
	depends on USER_BUSYBOX_CHCON && USER_BUSYBOX_GETOPT_LONG
	help
	  Support long options for the chcon applet.

config USER_BUSYBOX_GETENFORCE
	bool "getenforce"
	default n
	depends on USER_BUSYBOX_SELINUX
	help
	  Enable support to get the current mode of SELinux.

config USER_BUSYBOX_GETSEBOOL
	bool "getsebool"
	default n
	depends on USER_BUSYBOX_SELINUX
	help
	  Enable support to get SELinux boolean values.

config USER_BUSYBOX_MATCHPATHCON
	bool "matchpathcon"
	default n
	depends on USER_BUSYBOX_SELINUX
	help
	  Enable support to get default security context of the
	  specified path from the file contexts configuration.

config USER_BUSYBOX_RUNCON
	bool "runcon"
	default n
	depends on USER_BUSYBOX_SELINUX
	help
	  Enable support to run command in speficied security context.

config USER_BUSYBOX_FEATURE_RUNCON_LONG_OPTIONS
	bool "Enable long options"
	default y
	depends on USER_BUSYBOX_RUNCON && USER_BUSYBOX_GETOPT_LONG
	help
	  Support long options for the runcon applet.

config USER_BUSYBOX_SELINUXENABLED
	bool "selinuxenabled"
	default n
	depends on USER_BUSYBOX_SELINUX
	help
	  Enable support for this command to be used within shell scripts
	  to determine if selinux is enabled.

config USER_BUSYBOX_SETENFORCE
	bool "setenforce"
	default n
	depends on USER_BUSYBOX_SELINUX
	help
	  Enable support to modify the mode SELinux is running in.

endmenu
```
